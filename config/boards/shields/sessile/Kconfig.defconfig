## config/boards/shields/sessile/Kconfig.defconfig
```kconfig
# Copyright (c) 2022 The ZMK Contributors
# SPDX-License-Identifier: MIT

if SHIELD_SESSILE_DONGLE || SHIELD_SESSILE_CENTRAL

config ZMK_KEYBOARD_NAME
    default "sessile"

config ZMK_USB
	default y

endif

if SHIELD_SESSILE_DONGLE

config ZMK_SPLIT_ROLE_CENTRAL
    default y

endif

if SHIELD_SESSILE_PERIPHERAL || SHIELD_SESSILE_DONGLE
config ZMK_SPLIT
    default y
config ZMK_BLE
	default y
endif
```

## config/boards/shields/sessile/Kconfig.shield
```kconfig
# Copyright (c) 2022 The ZMK Contributors
# SPDX-License-Identifier: MIT

config SHIELD_SESSILE_CENTRAL
    def_bool $(shields_list_contains,sessile_central)

config SHIELD_SESSILE_PERIPHERAL
    def_bool $(shields_list_contains,sessile_peripheral)

config SHIELD_SESSILE_DONGLE
    def_bool $(shields_list_contains,sessile_dongle)
```

## config/west.yml
```yaml
manifest:
  remotes:
    - name: zmkfirmware
      url-base: https://github.com/zmkfirmware
    - name: urob
      url-base: https://github.com/urob
    - name: ssbb
      url-base: https://github.com/ssbb
  projects:
    - name: zmk
      remote: zmkfirmware
      revision: main
      import: app/west.yml
    - name: zmk-auto-layer
      remote: urob
      revision: main
    - name: zmk-helpers
      remote: urob
      revision: main
    - name: zmk-antecedent-morph
      remote: ssbb
      revision: v1
  self:
    path: zmk-config
```
